#include <util/delay.h>
#define F_CPU 100000UL

char *str = " 21:44:32 ";

unsigned char font[6][48] = {  // ASCII range 32-127, starts at 32, 4 bits per row (-> 96/2 = 48 bytes for 96 chars), 6 rows.
  {0x04, 0xaa, 0xad, 0x44, 0x24, 0x00, 0x00, 0x01, 0x64, 0x66, 0x2f, 0x7f, 0x66,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 0x46, 0x0f},
  {0x04, 0xaf, 0xed, 0xa4, 0x42, 0xa4, 0x00, 0x01, 0x9c, 0x99, 0x68, 0x81, 0x99,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 0x42, 0x59},
  {0x04, 0x0a, 0x22, 0x40, 0x42, 0x4e, 0x0e, 0x02, 0xb4, 0x12, 0xae, 0xe2, 0x69,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 0x41, 0xaf},
  {0x04, 0x0f, 0x04, 0xa0, 0x42, 0xa4, 0x00, 0x04, 0xd4, 0x21, 0xf1, 0x94, 0x97,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 0x42, 0x09},
  {0x00, 0x0a, 0x0b, 0x90, 0x42, 0x00, 0x40, 0x08, 0x94, 0x49, 0x21, 0x94, 0x91,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 0x42, 0x0f},
  {0x04, 0x0a, 0x0b, 0x60, 0x24, 0x00, 0x80, 0x48, 0x6e, 0xf6, 0x2e, 0x64, 0x66,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 0x44, 0x0f}
};

unsigned char image[6] = {
  font[0][20],
  font[1][20],
  font[2][20],
  font[3][20],
  font[4][20],
  font[5][20]
};

void imageFromString(char *str, int pixoffset)
{
  for (char i = 0; i < 6; i++)
    image[i] = 0;
  for (int px = 0; px < 6; px++)
  {
     int x = px + pixoffset;
     if (x % 5 == 4)
       continue;                 // put a blank column in after every char (every 5th column, i.e. 4, 9, 14...)
     x = x / 5 * 4 + (x % 5);    // collapse the x value to wrap intervals of 5 into intervals of 4; add the remainder back on. (We've already verified that the remainder != 4) (this effectively removes the blank spacing from our lookup)
     char c = str[x >> 2] - 32;  // - 32 because our font starts at 32.
     for (int y = 0; y < 6; y++)
     {
       char bits = font[y][c >> 1];
       bits &= 0x80 >> (((c & 0x1) << 2) | (x & 0x3));  // build a number by multiplying the lsb of the char by four, and then adding the (string pos->) x % 4 of the pixel. This is the bit offset of the pixel we need; mask this from our bit chunk.
       if (bits)                                        // check if our masked bit is true
         image[y] |= 0x80 >> px;                        // set this pixel to true (the whole thing was cleared earlier, no need to set to 0 if not true.)
     }
  }
}
       
void display()
{
  // switch on each row in turn, and push out the columns:
  for(int i = 0; i < 6; i++)
  {
    PORTD = image[i];
    PORTC = ~(0x01 << i);
    _delay_us(50);
    PORTC = 0xff;
  }
}

void setup()
{
  DDRC = 0x3f;
  DDRD = 0xfc;

}

void loop()
{
  for(int x = 0; x < strlen(str) * 5 - 5; x++)
  {
    imageFromString(str, x);
    for (int i = 0; i < 20; i++)
    {
      display();
    }
  }
}
